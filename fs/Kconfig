## fs/Kconfig
```kconfig
config FS_IOMAP
	bool

source "fs/ext4/Kconfig"
source "fs/jbd2/Kconfig"

config FS_MBCACHE
	tristate
	default y if EXT2_FS=y && EXT2_FS_XATTR
	default y if EXT4_FS=y
	default m if EXT2_FS_XATTR || EXT4_FS

config EXPORTFS
	tristate

config FILE_LOCKING
	bool "Enable POSIX file locking API" if EXPERT
	default y

menu "Pseudo filesystems"

endmenu

config IO_WQ
	bool
```

## fs/ext4/Kconfig
```kconfig
config EXT4_FS
	tristate "The Extended 4 (ext4) filesystem"
	select JBD2
	select CRC16
	select CRYPTO
	select CRYPTO_CRC32C
	select FS_IOMAP
	select FS_ENCRYPTION_ALGS if FS_ENCRYPTION
```

## fs/proc/Kconfig
```kconfig
config PROC_FS
	bool "/proc file system support" if EXPERT
	default y

config PROC_SYSCTL
	bool "Sysctl support (/proc/sys)" if EXPERT
	depends on PROC_FS
	select SYSCTL
	default y

config PROC_PAGE_MONITOR
 	default y
	depends on PROC_FS && MMU
	bool "Enable /proc page monitoring" if EXPERT

config PROC_PID_ARCH_STATUS
	def_bool n
	depends on PROC_FS
```

## fs/sysfs/Kconfig
```kconfig
config SYSFS
	bool "sysfs file system support" if EXPERT
	default y
	select KERNFS
```

## kernel/bpf/Kconfig
```kconfig
config BPF
	bool

config HAVE_EBPF_JIT
	bool

config ARCH_WANT_DEFAULT_BPF_JIT
	bool
```

## kernel/dma/Kconfig
```kconfig
config HAS_DMA
	bool
	depends on !NO_DMA
	default y

config NEED_SG_DMA_LENGTH
	bool

config NEED_DMA_MAP_STATE
	bool

config ARCH_DMA_ADDR_T_64BIT
	def_bool 64BIT || PHYS_ADDR_T_64BIT

config SWIOTLB
	bool
	select NEED_DMA_MAP_STATE
```

## kernel/irq/Kconfig
```kconfig
config GENERIC_IRQ_PROBE
	bool

config GENERIC_IRQ_SHOW
       bool

config GENERIC_IRQ_EFFECTIVE_AFF_MASK
       bool

config GENERIC_PENDING_IRQ
	bool

config GENERIC_IRQ_MIGRATION
	bool

config HARDIRQS_SW_RESEND
       bool

config IRQ_DOMAIN
	bool

config IRQ_DOMAIN_HIERARCHY
	bool
	select IRQ_DOMAIN

config GENERIC_IRQ_MATRIX_ALLOCATOR
	bool

config GENERIC_IRQ_RESERVATION_MODE
	bool

config IRQ_FORCED_THREADING
       bool

config SPARSE_IRQ
	bool "Support sparse irq numbering" if MAY_HAVE_SPARSE_IRQ
```

## kernel/rcu/Kconfig
```kconfig
config TREE_RCU
	bool
	default y if SMP

config SRCU
	bool

config TREE_SRCU
	bool
	default y if SRCU && !TINY_RCU

config RCU_STALL_COMMON
	def_bool TREE_RCU

config RCU_NEED_SEGCBLIST
	def_bool ( TREE_RCU || TREE_SRCU || TASKS_RCU_GENERIC )

config RCU_NOCB_CPU
	bool "Offload RCU callback processing from boot-selected CPUs"
	depends on TREE_RCU
	depends on RCU_EXPERT || NO_HZ_FULL
	default n
```

## kernel/time/Kconfig
```kconfig
config CLOCKSOURCE_WATCHDOG
	bool

config ARCH_CLOCKSOURCE_INIT
	bool

config CLOCKSOURCE_VALIDATE_LAST_CYCLE
	bool

config GENERIC_TIME_VSYSCALL
	bool

config GENERIC_CLOCKEVENTS
	def_bool !LEGACY_TIMER_TICK

config GENERIC_CLOCKEVENTS_BROADCAST
	bool
	depends on GENERIC_CLOCKEVENTS

config GENERIC_CLOCKEVENTS_MIN_ADJUST
	bool

config GENERIC_CMOS_UPDATE
	bool

config HAVE_POSIX_CPU_TIMERS_TASK_WORK
	bool

config POSIX_CPU_TIMERS_TASK_WORK
	bool
	default y if POSIX_TIMERS && HAVE_POSIX_CPU_TIMERS_TASK_WORK


if GENERIC_CLOCKEVENTS
menu "Timers subsystem"

config TICK_ONESHOT
	bool

config NO_HZ_COMMON
	bool
	select TICK_ONESHOT

choice
	prompt "Timer tick handling"

config NO_HZ_FULL
	bool "Full dynticks system (tickless)"
	# NO_HZ_COMMON dependency
	# We need at least one periodic CPU for timekeeping
	depends on SMP
	depends on HAVE_CONTEXT_TRACKING
	# VIRT_CPU_ACCOUNTING_GEN dependency
	depends on HAVE_VIRT_CPU_ACCOUNTING_GEN
	select NO_HZ_COMMON
	select RCU_NOCB_CPU
	select VIRT_CPU_ACCOUNTING_GEN
	select IRQ_WORK
	select CPU_ISOLATION

endchoice

config CONTEXT_TRACKING
       bool

config HIGH_RES_TIMERS
	bool "High Resolution Timer Support"
	select TICK_ONESHOT

endmenu
endif
```

## kernel/trace/Kconfig
```kconfig
config HAVE_SYSCALL_TRACEPOINTS
	bool
	help
	  See Documentation/trace/ftrace-design.rst
```

## lib/Kconfig
```kconfig
config BINARY_PRINTF
	def_bool n

menu "Library routines"

config BITREVERSE
	tristate

config GENERIC_STRNCPY_FROM_USER
	def_bool !ARCH_HAS_STRNCPY_FROM_USER

config GENERIC_STRNLEN_USER
	def_bool !ARCH_HAS_STRNLEN_USER

config GENERIC_NET_UTILS
	bool

source "lib/math/Kconfig"

config GENERIC_PCI_IOMAP
	bool

config GENERIC_IOMAP
	bool
	select GENERIC_PCI_IOMAP

config ARCH_USE_CMPXCHG_LOCKREF
	bool

config ARCH_HAS_FAST_MULTIPLIER
	bool

config ARCH_USE_SYM_ANNOTATIONS
	bool

source "lib/crypto/Kconfig"

config CRC16
	tristate "CRC16 functions"

config CRC32
	tristate "CRC32/CRC32c functions"
	default y
	select BITREVERSE

config CRC32_SELFTEST
	tristate "CRC32 perform self test on init"
	depends on CRC32

choice
	prompt "CRC32 implementation"
	depends on CRC32
	default CRC32_SLICEBY8

config CRC32_SLICEBY8
	bool "Slice by 8 bytes"

endchoice

config HAS_IOMEM
	bool
	depends on !NO_IOMEM
	default y

config HAS_IOPORT_MAP
	bool
	depends on HAS_IOMEM && !NO_IOPORT_MAP
	default y

source "kernel/dma/Kconfig"

config SGL_ALLOC
	bool
	default n

config IOMMU_HELPER
	bool

config CHECK_SIGNATURE
	bool

config CPUMASK_OFFSTACK
	bool "Force CPU masks off stack" if DEBUG_PER_CPU_MAPS
	help
	  Use dynamic allocation for cpumask_var_t, instead of putting
	  them on the stack.  This is a bit more expensive, but avoids
	  stack overflow.

config CPU_RMAP
	bool
	depends on SMP

config DQL
	bool

config NLATTR
	bool

source "lib/vdso/Kconfig"

config SG_POOL
	def_bool n

config ARCH_HAS_PMEM_API
	bool


config ARCH_HAS_UACCESS_FLUSHCACHE
	bool

config ARCH_HAS_COPY_MC
	bool

config ARCH_STACKWALK
       bool

config STACKDEPOT
	bool
	select STACKTRACE

config STACK_HASH_ORDER
	int "stack depot hash size (12 => 4KB, 20 => 1024KB)"
	range 12 20
	default 20
	depends on STACKDEPOT


config SBITMAP
	bool
endmenu
```

## lib/vdso/Kconfig
```kconfig
# SPDX-License-Identifier: GPL-2.0

config HAVE_GENERIC_VDSO
	bool

config GENERIC_GETTIMEOFDAY
	bool

config GENERIC_VDSO_TIME_NS
	bool
```
