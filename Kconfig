## block/Kconfig
```kconfig
menuconfig BLOCK
       bool "Enable the block layer" if EXPERT
       default y
       select SBITMAP
       select SRCU

if BLOCK

config BLK_MQ_PCI
	def_bool PCI

config BLK_MQ_VIRTIO
	bool
	depends on VIRTIO
	default y

endif # BLOCK
```

## block/partitions/Kconfig
```kconfig
config MSDOS_PARTITION
	bool "PC BIOS (MSDOS partition tables) support" if PARTITION_ADVANCED
	default y

config EFI_PARTITION
	bool "EFI GUID Partition support" if PARTITION_ADVANCED
	default y
	select CRC32
```

## crypto/Kconfig
```kconfig
config XOR_BLOCKS
	tristate
menuconfig CRYPTO
	tristate "Cryptographic API"

if CRYPTO

config CRYPTO_ALGAPI
	tristate
	select CRYPTO_ALGAPI2

config CRYPTO_ALGAPI2
	tristate

config CRYPTO_HASH
	tristate
	select CRYPTO_HASH2
	select CRYPTO_ALGAPI

config CRYPTO_HASH2
	tristate
	select CRYPTO_ALGAPI2

config CRYPTO_CRC32C
	tristate "CRC32c CRC algorithm"
	select CRYPTO_HASH
	select CRC32

endif
```

## drivers/block/Kconfig
```kconfig
menuconfig BLK_DEV
	bool "Block devices"
	depends on BLOCK
	default y

config VIRTIO_BLK
	tristate "Virtio block driver"
	depends on VIRTIO
	select SG_POOL
```

## drivers/char/Kconfig
```kconfig
source "drivers/tty/Kconfig"

config VIRTIO_CONSOLE
	tristate "Virtio console"
	depends on TTY
	select HVC_DRIVER
	select VIRTIO

config RANDOM_TRUST_CPU
	bool "Trust the CPU manufacturer to initialize Linux's CRNG"
	depends on ARCH_RANDOM
	default n
```

## drivers/firmware/Kconfig
```kconfig
config FIRMWARE_MEMMAP
    bool "Add firmware-provided memory map to sysfs" if EXPERT
    default X86

config DMI_SCAN_MACHINE_NON_EFI_FALLBACK
	bool
```

## drivers/input/Kconfig
```kconfig
config INPUT
	tristate "Generic input layer (needed for keyboard, mouse, ...)" if EXPERT
	default y
```

## drivers/net/Kconfig
```kconfig
config NET_CORE
	default y
	bool "Network core driver support"

config VIRTIO_NET
	tristate "Virtio network driver"
	depends on VIRTIO
	select NET_FAILOVER

config NET_FAILOVER
	tristate "Failover driver"
	select FAILOVER
```

## drivers/pci/Kconfig
```kconfig
config HAVE_PCI
	bool

menuconfig PCI
	bool "PCI support"
	depends on HAVE_PCI

if PCI

config PCI_DOMAINS
	bool
	depends on PCI

source "drivers/pci/pcie/Kconfig"

config PCI_QUIRKS
	default y
	bool "Enable PCI quirk workarounds" if EXPERT

config PCI_LABEL
	def_bool y if (DMI || ACPI)
	select NLS

config VGA_ARB
	bool "VGA Arbitration" if EXPERT
	default y
	depends on (PCI && !S390)

config VGA_ARB_MAX_GPUS
	int "Maximum number of GPUs"
	default 16
	depends on VGA_ARB

endif
```

## drivers/pci/pcie/Kconfig
```kconfig
config PCIEASPM
	bool "PCI Express ASPM control" if EXPERT
	default y

choice
	prompt "Default ASPM policy"
	default PCIEASPM_DEFAULT
	depends on PCIEASPM

config PCIEASPM_DEFAULT
	bool "BIOS default"
	depends on PCIEASPM
endchoice
```

## drivers/tty/Kconfig
```kconfig
config TTY
	bool "Enable TTY" if EXPERT
	default y

if TTY

config VT
	bool "Virtual terminal" if EXPERT
	select INPUT
	default y if !UML

config CONSOLE_TRANSLATIONS
	depends on VT
	default y
	bool "Enable character translations in console" if EXPERT

config VT_CONSOLE
	bool "Support for console on virtual terminal" if EXPERT
	depends on VT
	default y

config VT_CONSOLE_SLEEP
	def_bool y
	depends on VT_CONSOLE && PM_SLEEP

config HW_CONSOLE
	bool
	depends on VT
	default y

config UNIX98_PTYS
	bool "Unix98 PTY support" if EXPERT
	default y

config VT_HW_CONSOLE_BINDING
	bool "Support for binding and unbinding console drivers"
	depends on HW_CONSOLE

source "drivers/tty/serial/Kconfig"

source "drivers/tty/hvc/Kconfig"

endif # TTY
```

## drivers/tty/serial/8250/Kconfig
```kconfig
config SERIAL_8250
	tristate "8250/16550 and compatible serial support"
	depends on !S390
	select SERIAL_CORE
	select SERIAL_MCTRL_GPIO if GPIOLIB

config SERIAL_8250_CONSOLE
	bool "Console on 8250/16550 and compatible serial port"
	depends on SERIAL_8250=y
	select SERIAL_CORE_CONSOLE
	select SERIAL_EARLYCON

config SERIAL_8250_NR_UARTS
	int "Maximum number of 8250/16550 serial ports"
	depends on SERIAL_8250
	default "4"

config SERIAL_8250_RUNTIME_UARTS
	int "Number of 8250/16550 serial ports to register at runtime"
	depends on SERIAL_8250
	range 0 SERIAL_8250_NR_UARTS
	default "4"
```

## drivers/tty/serial/Kconfig
```kconfig
config SERIAL_EARLYCON
	bool
	depends on SERIAL_CORE

config SERIAL_CORE
	tristate

config SERIAL_CORE_CONSOLE
	bool

source "drivers/tty/serial/8250/Kconfig"
```

## drivers/video/console/Kconfig
```kconfig
config VGA_CONSOLE
	bool "VGA text console" if EXPERT || !X86
	depends on !4xx && !PPC_8xx && !SPARC && !M68K && !PARISC &&  !SUPERH && \
		(!ARM || ARCH_FOOTBRIDGE || ARCH_INTEGRATOR || ARCH_NETWINDER) && \
		!ARM64 && !ARC && !MICROBLAZE && !OPENRISC && !S390 && !UML
	default y

config DUMMY_CONSOLE
	bool
	default y

config DUMMY_CONSOLE_COLUMNS
	int "Initial number of console screen columns"
	depends on DUMMY_CONSOLE && !ARM
	default 160 if PARISC
	default 80

config DUMMY_CONSOLE_ROWS
	int "Initial number of console screen rows"
	depends on DUMMY_CONSOLE && !ARM
	default 64 if PARISC
	default 25
```

## drivers/virtio/Kconfig
```kconfig
# SPDX-License-Identifier: GPL-2.0-only
config VIRTIO
	tristate

config VIRTIO_PCI_LIB
	tristate

config VIRTIO_PCI_LIB_LEGACY
	tristate

menuconfig VIRTIO_MENU
	bool "Virtio drivers"
	default y

if VIRTIO_MENU

config VIRTIO_PCI
	tristate "PCI driver for virtio devices"
	depends on PCI
	select VIRTIO_PCI_LIB
	select VIRTIO

config VIRTIO_PCI_LEGACY
	bool "Support for legacy virtio draft 0.9.X and older devices"
	default y
	depends on VIRTIO_PCI
	select VIRTIO_PCI_LIB_LEGACY

endif # VIRTIO_MENU
```
